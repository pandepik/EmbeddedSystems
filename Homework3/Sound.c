// Sound.c, 
// This module contains the SysTick ISR that plays sound
// Runs on LM4F120 or TM4C123
// Program written by: put your names here
// Date Created: 7/7/2014 
// Last Modified:  
// Lab number: 5
// put code definitions for the software (actual C code)
// this file explains how the module works

#include "../inc/tm4c123gh6pm.h"
#include "dac.h"   // will call DAC module functions from this module so include
#include <stdint.h>
#include "piano.h"

//--UUU--
// Declare 4-bit 32-element sine wave table as an array (see dac.xls)
// Also declare other globals like index into the wave table
uint32_t piano[61] = {0, 1, 2, 3, 4, 5, 6, 7, 8, 9, 10, 11, 
	12, 13, 14, 15, 14, 13, 12, 11, 10, 9, 8, 7, 6, 5, 4, 3, 2, 
	1, 0, 1, 2, 3, 4, 5, 6, 7, 8, 9, 10, 11, 12, 13, 14, 15, 14, 
	13, 12, 11, 10, 9, 8, 7, 6, 5, 4, 3, 2, 1, 0};

unsigned char bassdrum[9236] = {32,31,31,32,32,31,31,32,32,32,31,31,32,32,31,32,31,32,31,32,31,31,32,31,31,31,32,31,32,32,
	32,32,32,32,32,32,33,33,34,34,34,34,30,32,32,33,32,31,31,31,31,31,31,31,31,31,31,31,32,32,32,32,31,31,30,30,30,30,31,31,
	32,33,33,34,34,33,33,32,31,31,30,30,31,33,35,37,39,41,42,41,39,35,31,27,24,24,26,28,30,31,31,30,28,26,23,21,19,19,18,19,
	20,21,22,24,25,27,29,31,33,35,37,39,41,42,44,45,45,46,45,45,44,42,41,39,37,34,32,29,27,24,22,20,18,17,16,15,15,15,16,17,
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	37,37,37,37,37,37,38,38,38,38,38,38,38,39,39,39,39,39,39,39,39,39,39,39,39,39,39,39,39,39,39,39,39,39,39,39,39,39,39,39,39,
	38,38,38,38,38,38,38,38,37,37,37,37,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31,31};

	unsigned char ba_da_dum[8105] = {32,43,42,42,39,37,35,32,28,24,22,39,19,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22,33};

	unsigned char no_sound[2] = {0};
	
uint32_t idx = 0;	
uint32_t i = 0;
uint32_t count = 0x0FFFFFFF;
uint32_t count2 = 7000;
extern uint8_t input, input2;
extern uint8_t b_input;
extern uint8_t p_input;	
// **************Sound_Init*********************
// Initialize Systick periodic interrupts
// Input: Initial interrupt period
//           Units to be determined by YOU
//           Maximum to be determined by YOU
//           Minimum to be determined by YOU
// Output: none
void Sound_Init(uint32_t period){
  //--UUU--
	//  Call DAC_Init and  other sound related initalization 
		DAC_Init();
		SYSCTL_RCGCGPIO_R |= 0x20;
		while((SYSCTL_RCGCGPIO_R&0x20) == 0) {};
		GPIO_PORTF_LOCK_R |= 0x4C4F434B;
		GPIO_PORTF_CR_R |= 0x1F;
		GPIO_PORTF_DIR_R |= 0x0C;
//		GPIO_PORTF_PUR_R |= 0x11;
		GPIO_PORTF_AFSEL_R &= ~0x1F;
		GPIO_PORTF_DEN_R |= 0x1D;
		NVIC_ST_CTRL_R = 0;
		NVIC_ST_RELOAD_R = period;	//Set the period length
		NVIC_SYS_PRI3_R = (NVIC_SYS_PRI3_R&0x00FFFFFF)|0x20000000;
		NVIC_ST_CTRL_R = 0x07;					//Enable SysTick with Interrupts
}

// **************Sound_Play*********************
// Start sound output, and set Systick interrupt period 
// Input: interrupt period
//           Units to be determined by YOU
//           Maximum to be determined by YOU
//           Minimum to be determined by YOU
//         input of zero disables sound output
// Output: none
void Sound_Play(uint32_t start){
  //--UUU--
	//  change the note by changing when systick interrupts
	i = start;
	if(i < 8105){
		DAC_Out(ba_da_dum[i]);
		while(count2 > 0){
			count2--;
		}
		Sound_Play(i++);
	}
	return;
}
// Interrupt service routine
// Executed periodically, the actual period
// determined by the current Reload.
void SysTick_Handler(void){
	//--UUU--
	//  Write one sample out to the DAC 
		GPIO_PORTF_DATA_R ^= 0x08;
		if(input == 0x00){
				if(p_input == 0x00){
					DAC_Out(bassdrum[idx]);
					idx = (idx + 1)%9236;
			}
				else if(p_input == 0x01){
					DAC_Out(ba_da_dum[idx]);
					idx = (idx + 1)%8105;
					if(idx == 8105){
						while(count>0){
							DAC_Out(0);
							count--;
						}
						count = 0x0FFFFFFF;
					}
				}					
		}
		else{
			DAC_Out(0);
			}
}
